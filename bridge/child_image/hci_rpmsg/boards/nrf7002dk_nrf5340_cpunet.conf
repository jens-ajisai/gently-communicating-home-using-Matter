## bridge/child_image/hci_rpmsg/boards/nrf7002dk_nrf5340_cpunet.conf
```kconfig
# This target uses Kconfig.hci_rpmsg.defaults to set options common for all
# samples using hci_rpmsg. This file should contain only options specific for this sample
# hci_rpmsg configuration or overrides of default values.

# Disable not used modules that cannot be set in Kconfig.hci_rpmsg.defaults due to overriding
# in board files.

CONFIG_BT_MAX_CONN=2
CONFIG_BT_CENTRAL=y

CONFIG_ASSERT=n
CONFIG_DEBUG_INFO=n
CONFIG_EXCEPTION_STACK_TRACE=n
CONFIG_RESET_ON_FATAL_ERROR=y

CONFIG_SERIAL=n
CONFIG_CONSOLE=n

CONFIG_PRINTK=n
CONFIG_LOG=n

# reduce size
CONFIG_BOOT_BANNER=n
CONFIG_SPI=n
CONFIG_I2C=n
```

## bridge/child_image/mcuboot/boards/nrf7002dk_nrf5340_cpuapp.conf
```kconfig
CONFIG_GPIO=y

CONFIG_ASSERT=n
CONFIG_DEBUG=n
CONFIG_LOG=n
CONFIG_USB_DEVICE_STACK=n

# Use minimal C library instead of the Picolib
CONFIG_MINIMAL_LIBC=y
```

## bridge/child_image/mcuboot/boards/ssci_mdbt53_dev_board_cpuapp.conf
```kconfig
# This content should be inside 
#   bootloader/mcuboot/boot/zephyr/boards/ssci_mdbt53_dev_board_cpuapp.conf
# However for some reason it is not applied during the mcuboot build.

CONFIG_SIZE_OPTIMIZATIONS=y

CONFIG_SYSTEM_CLOCK_NO_WAIT=y

CONFIG_MAIN_STACK_SIZE=10240
CONFIG_MBEDTLS_CFG_FILE="mcuboot-mbedtls-cfg.h"

CONFIG_BOOT_MAX_IMG_SECTORS=2048
CONFIG_BOOT_SIGNATURE_TYPE_RSA=y

# Flash
CONFIG_FLASH=y
CONFIG_BOOT_ERASE_PROGRESSIVELY=y
CONFIG_SOC_FLASH_NRF_EMULATE_ONE_BYTE_WRITE_ACCESS=y

# Serial
CONFIG_SERIAL=y
CONFIG_UART_LINE_CTRL=y

# MCUBoot serial
CONFIG_GPIO=y
CONFIG_MCUBOOT_SERIAL=y
CONFIG_MCUBOOT_SERIAL_DIRECT_IMAGE_UPLOAD=y
CONFIG_BOOT_SERIAL_CDC_ACM=y
CONFIG_BOOT_SERIAL_UART=n
CONFIG_BOOT_MAX_LINE_INPUT_LEN=4096
CONFIG_BOOT_LINE_BUFS=6
CONFIG_BOOT_SERIAL_MAX_RECEIVE_SIZE=24576

CONFIG_USB_CDC_ACM_RINGBUF_SIZE=4096
CONFIG_USB_REQUEST_BUFFER_SIZE=1024

# Required by QSPI
CONFIG_NORDIC_QSPI_NOR=y
CONFIG_NORDIC_QSPI_NOR_FLASH_LAYOUT_PAGE_SIZE=4096
CONFIG_NORDIC_QSPI_NOR_STACK_WRITE_BUFFER_SIZE=16

# Required by USB and QSPI
CONFIG_MULTITHREADING=y

# USB
CONFIG_USB_DEVICE_MANUFACTURER="Switch Science, Inc."
CONFIG_USB_DEVICE_PRODUCT="mcuboot SSCI MDBT53 Dev Board"
CONFIG_USB_DEVICE_VID=0x1915
CONFIG_USB_DEVICE_PID=0x5300
CONFIG_USB_CDC_ACM=y

# The following configurations are required to support simultaneous multi image update
CONFIG_PCD_APP=y
CONFIG_UPDATEABLE_IMAGE_NUMBER=2
CONFIG_BOOT_UPGRADE_ONLY=y
# The network core cannot access external flash directly. The flash simulator must be used to
# provide a memory region that is used to forward the new firmware to the network core.
CONFIG_FLASH_SIMULATOR=y
CONFIG_FLASH_SIMULATOR_DOUBLE_WRITES=y
CONFIG_FLASH_SIMULATOR_STATS=n

# Enable custom command to erase settings partition.
CONFIG_ENABLE_MGMT_PERUSER=y
CONFIG_BOOT_MGMT_CUSTOM_STORAGE_ERASE=y


# Decrease memory footprint
CONFIG_CBPRINTF_NANO=y
CONFIG_CONSOLE=n
CONFIG_UART_CONSOLE=n
CONFIG_CONSOLE_HANDLER=n
CONFIG_USE_SEGGER_RTT=n
CONFIG_PM=n
CONFIG_LOG=n

CONFIG_HW_CC3XX=n
CONFIG_NRF_CC3XX_PLATFORM=n
CONFIG_SPI=n
CONFIG_I2C=n

CONFIG_MCUBOOT_INDICATION_LED=y

# Use minimal C library instead of the Picolib
CONFIG_MINIMAL_LIBC=y
```

## bridge/child_image/multiprotocol_rpmsg/boards/ssci_mdbt53_dev_board_cpunet.conf
```kconfig
#
# Copyright (c) 2022 Nordic Semiconductor ASA
#
# SPDX-License-Identifier: LicenseRef-Nordic-5-Clause
#

# This target uses Kconfig.multiprotocol_rpmsg.defaults to set options common for all
# samples using multiprotocol_rpmsg. This file should contain only options specific for this sample
# multiprotocol_rpmsg configuration or overrides of default values.

# Disable not used modules that cannot be set in Kconfig.multiprotocol_rpmsg.defaults due to overriding
# in board files.

# will never fit into flash
CONFIG_ASSERT=n

#CONFIG_DEBUG=y
#CONFIG_DEBUG_OPTIMIZATIONS=y

CONFIG_DEBUG_INFO=y
CONFIG_EXCEPTION_STACK_TRACE=y
CONFIG_RESET_ON_FATAL_ERROR=n

CONFIG_BT_MAX_CONN=2
CONFIG_BT_CENTRAL=y

CONFIG_SERIAL=y
CONFIG_CONSOLE=y
CONFIG_UART_CONSOLE=y
CONFIG_NRFX_UARTE0=y

CONFIG_CBPRINTF_NANO=y
CONFIG_PRINTK=y

CONFIG_LOG=y
CONFIG_LOG_MODE_MINIMAL=n
CONFIG_LOG_MODE_IMMEDIATE=y
CONFIG_USE_SEGGER_RTT=y
CONFIG_LOG_BACKEND_RTT=y
CONFIG_LOG_BACKEND_UART=y

# reduce size
CONFIG_BOOT_BANNER=n
CONFIG_SPI=n
CONFIG_I2C=n
```

## postureChecker/sample.yaml
```yaml
sample:
  description: posture checker for the make it matter contest
  name: posture checker
tests:
  posture_checker.debug:
    build_only: true
    integration_platforms:
      - xiao_ble_sense
    platform_allow: xiao_ble_sense
```
